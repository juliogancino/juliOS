## config/julios_defconfig
```kconfig
# Buildroot configuración automática para JuliOS
# Copiar este archivo a buildroot-2024.02/.config

BR2_HAVE_DOT_CONFIG=y
BR2_x86_64=y
BR2_ARCH="x86_64"

# Sistema base
BR2_SYSTEM_DHCP="eth0"
BR2_TARGET_GENERIC_GETTY=n
BR2_TARGET_GENERIC_GETTY_PORT="tty1"

# Kernel Linux
BR2_LINUX_KERNEL=y
BR2_LINUX_KERNEL_CUSTOM_VERSION=y
BR2_LINUX_KERNEL_CUSTOM_VERSION_VALUE="6.1.24"
BR2_LINUX_KERNEL_USE_ARCH_DEFAULT_CONFIG=y

# Init system - BusyBox (minimal)
BR2_INIT_BUSYBOX=y
BR2_SYSTEM_INIT="/sbin/init"

# Componentes mínimos
BR2_PACKAGE_BUSYBOX=y
BR2_PACKAGE_UTIL_LINUX=y

# Networking
BR2_PACKAGE_IPTABLES=y

# Herramientas de desarrollo
BR2_PACKAGE_ZLIB=y
BR2_PACKAGE_HOST_GCC=y
BR2_PACKAGE_HOST_GCC_TARGET_ARCH="x86_64"

# System
BR2_TARGET_ROOTFS_EXT2=n
BR2_TARGET_ROOTFS_CPIO=y
BR2_TARGET_ROOTFS_CPIO_GZIP=y

# Strip binaries para reducir tamaño
BR2_STRIP=y
BR2_TARGET_ROOTFS_COMPRESSION_NONE=y

# Optimizaciones
BR2_OPTIMIZE_2=y
BR2_TARGET_GENERIC_REMOUNT_ROOTFS_RW=y
```
